## boards/shields/corne_dongle/Kconfig.shield
```kconfig
# No whitespace after the comma or in the keyboard name!
config SHIELD_CORNE_DONGLE
    def_bool $(shields_list_contains,corne_dongle)
# No whitespace after the comma or in your part name!
config SHIELD_CORNE_LEFT
    def_bool $(shields_list_contains,corne_left)

# No whitespace after the comma or in your part name!
config SHIELD_CORNE_RIGHT
    def_bool $(shields_list_contains,corne_right)
```
